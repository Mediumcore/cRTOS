## arch/x86_64/Kconfig
```kconfig
#
# For a description of the syntax of this configuration file,
# see the file kconfig-language.txt in the NuttX tools repository.
#

if ARCH_X86_64
comment "x86_64 Configuration Options"

choice
	prompt "x86_64 arch selection"
	default ARCH_INTEL64

config ARCH_INTEL64
	bool "Intel x86_64"
	select ARCH_HAVE_MPU
	select ARCH_USE_MPU
    select ARCH_HAVE_TICKLESS
    select ARCH_HAVE_STACKCHECK
    select ARCH_HAVE_VFORK
    select SCHED_TICKLESS_ALARM
	---help---
		Intel x86_64 architecture

endchoice

choice
	prompt "x86_64 chip selection"
	default ARCH_CHIP_BROADWELL

config ARCH_CHIP_BROADWELL
	bool "Intel Processor codename Broadwell"
	---help---
		Targeting those codenamed as broadwell

endchoice

config ARCH_CHIP
	string
	default "broadwell" if ARCH_CHIP_BROADWELL

source arch/x86_64/src/common/Kconfig
if ARCH_INTEL64_BROADWELL
source arch/x86_64/src/intel64/Kconfig
endif # ARCH_INTEL64_BROADWELK

if ARCH_CHIP_BROADWELL
source arch/x86_64/src/broadwell/Kconfig
endif # ARCH_CHIP_BROADWELL
endif # ARCH_X86_64
```

## configs/jailhouse-intel64/Kconfig
```kconfig
#
# For a description of the syntax of this configuration file,
# see the file kconfig-language.txt in the NuttX tools repository.
#

if ARCH_BOARD_JAILHOUSE_INTEL64

config COMM_REGION_BASE
	int "Jailhouse comm region base address"
	default 0x40000000
	---help---
		The base address of communication region with jailhouse

menuconfig NET_IVSHMEM_NET
	bool "IVShmem based Ethernet"
	default n
	---help---
		A ivshmem-net model based on ivshmem 2.

if NET_IVSHMEM_NET

config NET_IVSHMEM_NET_RX_DESC
	int "Number of RX descriptors"
	default 64

config NET_IVSHMEM_NET_TX_DESC
	int "Number of TX descriptors"
	default 32

config IVSHMEM_NET_MAC_ADDR
	hex "MAC0 address location"
	default 0xdeadbeef00

config IVSHMEM_NET_IPADDR
	hex "Target IP address"
	default 0xac100002

config IVSHMEM_NET_DRIPADDR
	hex "Default Router IP address (Gateway)"
	default 0xac100001

config IVSHMEM_NET_NETMASK
	hex "Network Mask"
	default 0xffffff00

choice
	prompt "Work queue"
	default IVSHMEM_NET_LPWORK if SCHED_LPWORK
	default IVSHMEM_NET_HPWORK if !SCHED_LPWORK && SCHED_HPWORK
	depends on SCHED_WORKQUEUE
	---help---
		Work queue support is required to use the ivshmem-net driver.  If the
		low priority work queue is available, then it should be used by the
		ivshmem-net driver.

config IVSHMEM_NET_HPWORK
	bool "High priority"
	depends on SCHED_HPWORK

config IVSHMEM_NET_LPWORK
	bool "Low priority"
	depends on SCHED_LPWORK

endchoice # Work queue

endif

config ENABLE_C1_STATE
	bool "Enable C1 state on idle"
	default n
    depends on !SCHED_TICKLESS
	---help---
		Enable C1 State during idle to save power.

endif
```

## drivers/pcie/Kconfig
```kconfig
#
# For a description of the syntax of this configuration file,
# see the file kconfig-language.txt in the NuttX tools repository.
#

if PCIE
config PCIE_DEV_TYPE_NUM
	int "Number of device types"
	default 8

config PCIE_IO_REMAP_NUM
	int "Number of PCI-E I/O remap"
	default 32

config PCIE_IO_REMAP_START
	hex "Strating Address of PCI-E I/O remap region"
	default 0xfffe0000

endif # I2C
```
